; J. LELAY, B. SECHEHAYE, G2I05_3I-IN1 - ESIEE Paris -
; 11/2020 - Evalbot (Cortex M3 de Texas Instrument)
; Main loop

GPIO_6			EQU		0x40
PORTD_BASE		EQU		0x40007000

		AREA    |.text|, CODE, READONLY
		ENTRY
		EXPORT	__main

		IMPORT	INIT
		IMPORT	MOTEUR_PIVOTE_DROITE
		IMPORT	MOTEUR_PIVOTE_GAUCHE
		IMPORT	MOTEUR_DEMI_TOUR
		IMPORT	MOTEUR_AVANCE
		IMPORT	CHOIX_DIRECTION
		IMPORT	SOLVE_MAZE
		
__main	  		   

		; initialization
		; Configure GPIO
		BL	INIT
		
		; Beginning control
		; Read SW1 state
nogo	LDR R12,= (PORTD_BASE + (GPIO_6<<2))
		LDR	R11, [R12]
		; If SW1 is not active(!=40), don't start. Else, keep going
		CMP R11,#GPIO_6
		BEQ	nogo

		BL	MOTEUR_DEMI_TOUR
		BL	MOTEUR_AVANCE
		BL	MOTEUR_PIVOTE_GAUCHE
		BL	MOTEUR_AVANCE
		BL	MOTEUR_AVANCE
		BL	MOTEUR_AVANCE
		BL	MOTEUR_AVANCE
		BL	MOTEUR_PIVOTE_GAUCHE
		BL	MOTEUR_AVANCE
		BL	MOTEUR_AVANCE
		BL	MOTEUR_PIVOTE_DROITE
		BL	MOTEUR_AVANCE
		BL	MOTEUR_AVANCE
		BL	MOTEUR_AVANCE
		BL	MOTEUR_PIVOTE_DROITE
		BL	MOTEUR_AVANCE
		BL	MOTEUR_AVANCE
		BL	MOTEUR_AVANCE
		BL	MOTEUR_AVANCE
		BL	MOTEUR_PIVOTE_DROITE
		BL	MOTEUR_AVANCE
		BL	MOTEUR_PIVOTE_GAUCHE
		BL	MOTEUR_AVANCE
		BL	MOTEUR_AVANCE
		BL	MOTEUR_PIVOTE_DROITE
		BL	MOTEUR_AVANCE
		BL	MOTEUR_AVANCE
		BL	MOTEUR_AVANCE
		BL	MOTEUR_PIVOTE_GAUCHE
		BL	MOTEUR_AVANCE
		BL	MOTEUR_AVANCE 	; exit maze if arrived to its entry
		NOP
        END